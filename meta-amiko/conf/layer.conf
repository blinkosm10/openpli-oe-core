## meta-miraclebox/conf/machine/mbmicro.conf
```bitbake
#@TYPE: Machine
#@NAME: Miraclebox
#@DESCRIPTION: Machine configuration for the Miraclebox Premium Micro

SOC_FAMILY = "bcm7362"
CHIPSET = "bcm7362"

BRAND_OEM = "ceryon"
MACHINE_BRAND = "Miraclebox"
MACHINE_NAME = "Premium Micro"

FRIENDLY_FAMILY = "g7000s"
STB_PLATFORM = "g7000s"
MACHINE_MODEL = "g7000s"

KERNEL_FILE = "kernel.bin"
ROOTFS_FILE = "rootfs.bin"
MTD_KERNEL = "mtd1"
MTD_ROOTFS = "mtd2"

MACHINE_FEATURES += " HDMI AV_JACK blindscan-dvbs blindscan-dvbc dvb-c skins1080"

IMAGEDIR ?= "miraclebox/micro"

PREFERRED_VERSION_linux-${MACHINE} = "4.0.1"

MKUBIFS_ARGS = "-m 2048 -e 126976 -c 8192"
UBINIZE_ARGS = "-m 2048 -p 128KiB"

require conf/machine/include/miraclebox.inc
```

## meta-miraclebox/conf/machine/mbtwinplus.conf
```bitbake
#@TYPE: Machine
#@NAME: Miraclebox
#@DESCRIPTION: Machine configuration for the Miraclebox Premium Twin+

SOC_FAMILY = "bcm7241"
CHIPSET = "bcm7241"

BRAND_OEM = "broadmedia"
MACHINE_BRAND = "Miraclebox"
MACHINE_NAME = "Premium Twin Plus"

FRIENDLY_FAMILY = "g300s"
STB_PLATFORM = "g300s"
MACHINE_MODEL = "g300s"

KERNEL_FILE = "kernel.bin"
ROOTFS_FILE = "rootfs.bin"
MTD_KERNEL = "mtd1"
MTD_ROOTFS = "mtd2"

MACHINE_FEATURES += " HDMI RCA videoenhancement ci textlcd blindscan-dvbc dvb-c skins1080"

IMAGEDIR ?= "miraclebox/twinplus"

PREFERRED_VERSION_linux-${MACHINE} = "4.1.24"

MKUBIFS_ARGS = "-m 2048 -e 126976 -c 8192"
UBINIZE_ARGS = "-m 2048 -p 128KiB"

FORCE_REBOOT_OPTION = "reboot"

MACHINE_EXTRA_RDEPENDS += "enigma2-plugin-extensions-hbbtv-${MACHINE}"

require conf/machine/include/miraclebox.inc
```

## meta-sab/conf/layer.conf
```bitbake
# We have a conf and classes directory, append to BBPATH
BBPATH .= ":${LAYERDIR}"

BBFILES += "${LAYERDIR}/recipes-*/*/*.bb"

BSP-BASE-SAB := '${@os.path.normpath("${LAYERDIR}/")}'
```

## meta-sab/conf/machine/alphatriplehd.conf
```bitbake
#@TYPE: Machine
#@NAME: SAB Alpha Triple HD BOX 
#@DESCRIPTION: Machine configuration for the SAB Alphatriple

SOC_FAMILY = "bcm7241"
CHIPSET = "bcm7241"

BRAND_OEM = "broadmedia"
MACHINE_BRAND = "SAB"
MACHINE_NAME = "Alpha Triple HD"
MACHINE_MODEL = "g300"

FRIENDLY_FAMILY = "g300"
STB_PLATFORM = "g300"

KERNEL_FILE = "kernel.bin"
ROOTFS_FILE = "rootfs.bin"
MTD_KERNEL = "mtd1"
MTD_ROOTFS = "mtd2"

MACHINE_FEATURES += " videoenhancement ci textlcd blindscan-dvbc dvb-c skins1080 RCA HDMI"
DISTRO_FEATURES:remove = "x11 wayland directfb"

IMAGEDIR ?= "sab_alpha_triple"

MKUBIFS_ARGS = "-m 2048 -e 126976 -c 8192"
UBINIZE_ARGS = "-m 2048 -p 128KiB"

FORCE_REBOOT_OPTION = "reboot"

PREFERRED_VERSION_linux-sab = "4.1.24"
require conf/machine/include/sab-mipsel.inc
```

## meta-xpeedc/conf/machine/xpeedc.conf
```bitbake
#@TYPE: Machine
#@NAME: xpeedc
#@DESCRIPTION: Machine configuration for the xpeedc

SOC_FAMILY = "bcm7362"
CHIPSET = "bcm7362"

BRAND_OEM = "ultramini"
MACHINE_BRAND = "GOLDEN INTERSTAR"
MACHINE_NAME = "gi1"

FRIENDLY_FAMILY = "ultramini"
STB_PLATFORM = "ultramini"
MACHINE_MODEL = "ultramini"

KERNEL_FILE = "kernel.bin"
ROOTFS_FILE = "rootfs.bin"
MTD_KERNEL = "mtd1"
MTD_ROOTFS = "mtd2"

MACHINE_FEATURES += " videoenhancement textlcd blindscan-dvbc dvb-c skins1080 smallflash HDMI RCA"
DISTRO_FEATURES:remove = "x11 wayland directfb"

MKUBIFS_ARGS = "-m 2048 -e 126976 -c 8192"
UBINIZE_ARGS = "-m 2048 -p 128KiB"

PREFERRED_VERSION_linux-xpeedc-nextv = "4.1.21"
require conf/machine/include/xpeedc-nextv-mipsel.inc
```
