## meta-amiko/conf/layer.conf
```bitbake
# We have a conf and classes directory, append to BBPATH
BBPATH .= ":${LAYERDIR}"

BBFILES += "${LAYERDIR}/recipes-*/*/*.bb ${LAYERDIR}/recipes-*/*/*.bbappend"

BSP-BASE-AMIKO := '${@os.path.normpath("${LAYERDIR}/")}'
```

## meta-amiko/conf/machine/vipercombohdd.conf
```bitbake
#@TYPE: Machine
#@NAME: Viper Combo HDD
#@DESCRIPTION: Machine configuration for the Viper Combo HDD

SOC_FAMILY = "bcm73625"
CHIPSET = "bcm73625"

BRAND_OEM = "entwopia"
MACHINE_BRAND = "AMIKO"
MACHINE_NAME = "Viper Combo HDD"

FRIENDLY_FAMILY = "yh625dt"
STB_PLATFORM = "yh625dt"
MACHINE_MODEL = "yh625dt"

MKUBIFS_ARGS = "-m 2048 -e 126976 -c 4096"
UBINIZE_ARGS = "-m 2048 -p 128KiB -s 2048"

MTD_KERNEL = "mtd2"
MTD_ROOTFS = "mtd0"
KERNEL_FILE = "kernel.bin"
ROOTFS_FILE = "rootfs.bin"

MACHINE_FEATURES += " textlcd dvb-c hdmicec skins1080 ci RCA HDMI TIMERWAKEUP"

DVBMEDIASINK_CONFIG:append = " --with-h265 --with-vb6 --with-vb8 --with-spark"

RCTYPE = "18"

require conf/machine/include/amiko.inc
```

## meta-amiko/conf/machine/viperslim.conf
```bitbake
#@TYPE: Machine
#@NAME: Viper Slim
#@DESCRIPTION: Machine Configuration for the Viper Slim

SOC_FAMILY = "bcm73625"
CHIPSET = "bcm73625"

BRAND_OEM = "amiko"
MACHINE_BRAND = "AMIKO"
MACHINE_NAME = "Viper SLIM"

FRIENDLY_FAMILY = "yh73625"
STB_PLATFORM = "yh73625"
MACHINE_MODEL = "yh73625"

MKUBIFS_ARGS = "-m 2048 -e 126976 -c 4096"
UBINIZE_ARGS = "-m 2048 -p 128KiB -s 2048"

MTD_KERNEL = "mtd2"
MTD_ROOTFS = "mtd0"
KERNEL_FILE = "kernel.bin"
ROOTFS_FILE = "rootfs.bin"

MACHINE_FEATURES += " hdmicec skins1080 textlcd AV_JACK HDMI TIMERWAKEUP"

DVBMEDIASINK_CONFIG:append = " --with-h265 --with-vb6 --with-vb8 --with-spark"

RCTYPE = "18"

FORCE = "yes"

require conf/machine/include/amiko.inc
```

## meta-amiko/conf/machine/vipert2c.conf
```bitbake
#@TYPE: Machine
#@NAME: Viper T2C
#@DESCRIPTION: Machine configuration for the Viper T2C

SOC_FAMILY = "bcm73625"
CHIPSET = "bcm73625"

BRAND_OEM = "entwopia"
MACHINE_BRAND = "AMIKO"
MACHINE_NAME = "Viper T2/C"

FRIENDLY_FAMILY = "yh625tc"
STB_PLATFORM = "yh625tc"
MACHINE_MODEL = "yh625tc"

MKUBIFS_ARGS = "-m 2048 -e 126976 -c 4096"
UBINIZE_ARGS = "-m 2048 -p 128KiB -s 2048"

MTD_KERNEL = "mtd2"
MTD_ROOTFS = "mtd0"
KERNEL_FILE = "kernel.bin"
ROOTFS_FILE = "rootfs.bin"

MACHINE_FEATURES += " dvb-c AV_JACK textlcd hdmicec skins1080 HDMI TIMERWAKEUP"

DVBMEDIASINK_CONFIG:append = " --with-h265 --with-vb6 --with-vb8 --with-spark"

RCTYPE = "18"

FORCE = "yes"

require conf/machine/include/amiko.inc
```

## meta-dream/conf/machine/Include/dreambox-mips32el-nf.inc
```bitbake
# dreambox-mips32el-nf.inc

KERNELVERSION = "2.6.18"

BOX_BRAND = "dreambox"

TARGET_ARCH = "mipsel"
DEFAULTTUNE = "mips32el-nf"

MTD_KERNEL = "mtd2"

KERNEL_FILE = "kernel.bin"
ROOTFS_FILE = "rootfs.bin"

MACHINE_FEATURES_BACKFILL_CONSIDERED += "rtc"

OPTIONAL_BSP_PACKAGES += "dreambox-buildimage"
EXTRA_IMAGEDEPENDS += "dreambox-secondstage-${MACHINE}"

MACHINE_ESSENTIAL_EXTRA_RDEPENDS += "\
	dm-bootsplash \
	dm-shutdown \
	dm-startupfix \
	dreambox-boot-progress \
	dreambox-dvb-modules-${MACHINE} \
	kernel-module-md4 \
	v4l-dvb-module-dvb-core \
	v4l-dvb-module-stv0299 \
	"

GLIBC_EXTRA_OECONF = "--with-tls --with-__thread"
DVBMEDIASINK_CONFIG = "--with-dts=no"
OLDEST_KERNEL = "${KERNELVERSION}"
GLIBCVERSION_dm800 = "2.19"
PREFERRED_VERSION_glibc_dm800 = "2.19"
PREFERRED_VERSION_glibc-initial_dm800 = "2.19"

PREFERRED_VERSION_kernel-module-extrawlan-rtl8192cu = "3.3.0"
PREFERRED_VERSION_libnl = "3.2.24"
PREFERRED_VERSION_linux-dreambox = "${KERNELVERSION}"
PREFERRED_VERSION_linux-libc-headers = "${KERNELVERSION}"
PREFERRED_VERSION_wscan = "20130331"

MACHINE_FEATURES += "alsa usbhost switchoff dreambox oldkernel olde2api DVI wifiusblegacy"

PREFERRED_PROVIDER_virtual/bootloader = "dreambox-secondstage-${MACHINE}"
PREFERRED_PROVIDER_virtual/kernel = "linux-dreambox"

PREFERRED_PROVIDER_virtual/blindscan-dvbs = "dreambox-blindscan-utils"
PREFERRED_PROVIDER_virtual/blindscan-dvbc = "dreambox-blindscan-utils"

KERNEL_IMAGETYPE = "vmlinux"
KERNEL_OUTPUT = "${KERNEL_IMAGETYPE}"
KERNEL_OUTPUT_DIR = "."
KERNEL_CONSOLE = "${@bb.utils.contains('MACHINE_FEATURES', 'usbconsole', 'ttyS0,115200', 'null', d)}"

DREAMBOX_BUILDIMAGE = "buildimage --arch ${MACHINE} ${EXTRA_BUILDCMD} \
	--erase-block-size ${DREAMBOX_ERASE_BLOCK_SIZE} \
	--flash-size ${DREAMBOX_FLASH_SIZE} \
	--sector-size ${DREAMBOX_SECTOR_SIZE}"

require conf/machine/include/tune-mips32.inc

require conf/machine/include/dreambox-brcmnand.inc
require conf/machine/include/dreambox-nand-64mb.inc
require conf/machine/include/dreambox-part-64mb.inc
require conf/machine/include/dreambox-jffs2.inc

SOC_FAMILY = "bcm7401"
DVBPROVIDER = "v4l-dvb"

# Image fails to boot if kernel exceeds some unknown limit, so make that
# explicit here. I don't know what the actual limit is, but 6416679 boots
# and 6604470 didn't.
KERNEL_IMAGE_MAXSIZE = "6500000"

CFLAGS_append_pn-titan = " -DDREAMBOX "
```

## meta-dream/conf/machine/Include/dreambox.inc
```bitbake
# dreambox.inc
# We know about rtc
MACHINE_FEATURES_BACKFILL_CONSIDERED += "rtc"

EXTRA_IMAGEDEPENDS += "dreambox-secondstage-${MACHINE}"

MACHINE_ESSENTIAL_EXTRA_RDEPENDS += "\
	dreambox-dvb-modules-${MACHINE} \
	kernel-module-hmac \
	kernel-module-md4 \
	${@bb.utils.contains_any("MACHINE", "dm800se dm500hd", "kernel-module-ecb", "", d)} \
	dreambox-boot-progress \
	"

MACHINE_FEATURES += "alsa usbhost switchoff dreambox"

PREFERRED_PROVIDER_virtual/bootloader = "dreambox-secondstage-${MACHINE}"
PREFERRED_PROVIDER_virtual/kernel = "linux-dreambox"

PREFERRED_PROVIDER_virtual/blindscan-dvbs = "dreambox-blindscan-utils"
PREFERRED_PROVIDER_virtual/blindscan-dvbc = "dreambox-blindscan-utils"

KERNEL_IMAGETYPE = "vmlinux"
KERNEL_OUTPUT = "${KERNEL_IMAGETYPE}"
KERNEL_OUTPUT_DIR = "."
KERNEL_CONSOLE = "${@bb.utils.contains('MACHINE_FEATURES', 'usbconsole', 'ttyS0,115200', 'null', d)}"

DREAMBOX_BUILDIMAGE = "buildimage --arch ${MACHINE} ${EXTRA_BUILDCMD} \
	--erase-block-size ${DREAMBOX_ERASE_BLOCK_SIZE} \
	--flash-size ${DREAMBOX_FLASH_SIZE} \
	--sector-size ${DREAMBOX_SECTOR_SIZE}"
```

## meta-dream/conf/machine/include/dreambox-mips32el.inc
```bitbake
# dreambox-mips32el.inc

BOX_BRAND = "dreambox"

TARGET_ARCH = "mipsel"
DEFAULTTUNE = "mips32el"

MACHINE_ESSENTIAL_EXTRA_RDEPENDS += "\
	dm-bootsplash \
	kernel-module-stv0299 \
	libpagecache \
	libpassthrough \
	"

MTD_KERNEL = "mtd2"

require conf/machine/include/dreambox.inc
require conf/machine/include/tune-mips32.inc

DVBMEDIASINK_CONFIG = "--with-pcm --with-wma --with-wmv --with-dtsdownmix --with-eac3 --with-dts"

KERNELVERSION = "3.2"

FLASHSIZE = "64"

require conf/machine/include/dreambox-brcmnand.inc
require conf/machine/include/dreambox-nand-64mb.inc
require conf/machine/include/dreambox-part-64mb.inc
require conf/machine/include/dreambox-jffs2.inc

PREFERRED_VERSION_wscan = "20130331"
PREFERRED_VERSION_linux-dreambox = "${KERNELVERSION}"

SOC_FAMILY = "bcm7405"

# Image fails to boot if kernel exceeds some unknown limit, so make that
# explicit here. I don't know what the actual limit is, but 6416679 boots
# and 6604470 didn't.
KERNEL_IMAGE_MAXSIZE = "6500000"

MACHINE_FEATURES += "fan hdmicec HDMI"

CFLAGS_append_pn-titan = " -DDREAMBOX "

KERNEL_FILE = "kernel.bin"
ROOTFS_FILE = "rootfs.bin"
```

## meta-edision/conf/machine/include/edision-mips-common.inc
```bitbake
#
# Common configuration for all machines of the mips type
#

TARGET_ARCH = "mipsel"
DEFAULTTUNE = "mips32el"
require conf/machine/include/mips/tune-mips32.inc
```

## meta-edision/conf/machine/include/meta-edision.inc
```bitbake
#
# BSP variables and settings specific to the meta-edision layer
#

# We know about rtc
MACHINE_FEATURES_BACKFILL_CONSIDERED = "rtc"

# recommended extra packages common to all edision machines
MACHINE_ESSENTIAL_EXTRA_RRECOMMENDS:append = " kernel-module-rt2800usb"
MACHINE_EXTRA_RRECOMMENDS:append = " gst-plugin-dvbmediasink"
MACHINE_EXTRA_RRECOMMENDS:append = " enigma2-plugin-drivers-dvb-usb-opticombo"
MACHINE_EXTRA_RRECOMMENDS:append = " edision-splash"

# common machine features
MACHINE_FEATURES:append = " alsa wlan 3dtv switchoff osdposition hdmicec videoenhancement"
```

## meta-edision/conf/machine/osmega.conf
```bitbake
#@TYPE: Machine
#@NAME: Edision OS mega
#@DESCRIPTION: Machine configuration for the Edision OS mega

SOC_FAMILY = "bcm73565"
CHIPSET = "bcm73565"

BRAND_OEM = "xcore"
MACHINE_BRAND = "Edision"
MACHINE_NAME = "OS mega"

FRIENDLY_FAMILY = "xc7346"
STB_PLATFORM = "xc7346"
MACHINE_MODEL = "xc7346"

KERNEL_FILE = "kernel.bin"
ROOTFS_FILE = "rootfs.bin"
MTD_KERNEL = "mtd0"
MTD_ROOTFS = "mtd2"

MACHINE_FEATURES += "RCA HDMI blindscan-dvbs blindscan-dvbc textlcd dvb-c skins1080 ci xcore-mipsel"
OPENPLI_FEATURES += " kodi"

require conf/machine/include/meta-edision.inc
require conf/machine/include/edision-mips-common.inc
require conf/machine/include/edision-rootfs-ubi.inc

MACHINE_ESSENTIAL_EXTRA_RDEPENDS:append = " edision-dvb-modules-${MACHINE}"
MACHINE_ESSENTIAL_EXTRA_RRECOMMENDS:append = " kernel-module-r8723bs firmware-rtl8723bs"
MACHINE_ESSENTIAL_EXTRA_RRECOMMENDS:append = " kernel-module-hci-uart"

MACHINE_ESSENTIAL_EXTRA_RRECOMMENDS += " \
    kernel-module-cdfs \
    "

DVBMEDIASINK_CONFIG = "--with-wma --with-wmv --with-pcm --with-dts --with-eac3 --with-h265 --with-vb6 --with-vb8 --with-vb9 --with-spark"

PREFERRED_PROVIDER_virtual/blindscan-dvbs = "os-blindscan-utils"
PREFERRED_PROVIDER_virtual/blindscan-dvbc = "os-blindscan-utils"
PREFERRED_PROVIDER_virtual/kernel = "linux-os"
PREFERRED_VERSION_linux-os = "4.11"
PREFERRED_PROVIDER_virtual/egl = "v3d-libgles-${MACHINE}"
PREFERRED_PROVIDER_virtual/libgles2 = "v3d-libgles-${MACHINE}"

KERNEL_IMAGETYPE = "vmlinux.gz"
KERNEL_CONSOLE = "ttyS0,115200n8"

KERNEL_MODULE_AUTOLOAD:append = " r8723bs"
KERNEL_MODULE_AUTOLOAD:append = " hci_uart"
```

## meta-edision/conf/machine/osmini.conf
```bitbake
#@TYPE: Machine
#@NAME: Edision OS mini
#@DESCRIPTION: Machine configuration for the Edision OS mini

SOC_FAMILY = "bcm7362"
CHIPSET = "bcm7362"

BRAND_OEM = "xcore"
MACHINE_BRAND = "Edision"
MACHINE_NAME = "OS mini"

FRIENDLY_FAMILY = "xc7362"
STB_PLATFORM = "xc7362"
MACHINE_MODEL = "xc7362"

KERNEL_FILE = "kernel.bin"
ROOTFS_FILE = "rootfs.bin"
MTD_KERNEL = "mtd0"
MTD_ROOTFS = "mtd2"

MACHINE_FEATURES += " HDMI videoenhancement blindscan-dvbs blindscan-dvbc dvb-c skins1080 blindscan-tbs textlcd 7segment"

require conf/machine/include/meta-edision.inc
require conf/machine/include/edision-mips-common.inc
require conf/machine/include/edision-rootfs-ubi.inc

MACHINE_ESSENTIAL_EXTRA_RDEPENDS:append = " edision-dvb-modules-${MACHINE}"
MACHINE_ESSENTIAL_EXTRA_RRECOMMENDS:append = " kernel-module-r8723bs firmware-rtl8723bs"
MACHINE_ESSENTIAL_EXTRA_RRECOMMENDS:append = " kernel-module-hci-uart"

DVBMEDIASINK_CONFIG = "--with-wma --with-wmv --with-pcm --with-dts --with-eac3"

PREFERRED_PROVIDER_virtual/blindscan-dvbs = "os-blindscan-utils"
PREFERRED_PROVIDER_virtual/blindscan-dvbc = "os-blindscan-utils"
PREFERRED_PROVIDER_virtual/kernel = "linux-os"
PREFERRED_VERSION_linux-os = "4.11"

KERNEL_IMAGETYPE = "vmlinux.gz"
KERNEL_CONSOLE = "ttyS0,115200n8"

KERNEL_MODULE_AUTOLOAD:append = " r8723bs"
KERNEL_MODULE_AUTOLOAD:append = " hci_uart"
```

## meta-edision/conf/machine/osmio4kplus.conf
```bitbake
#@TYPE: Machine
#@NAME: Edision OS mio+ 4k
#@DESCRIPTION: Machine configuration for the Edision OS mio+ 4k

SOC_FAMILY = "bcm72604"
CHIPSET = "bcm72604"

BRAND_OEM = "edision"
MACHINE_BRAND = "Edision"
MACHINE_NAME = "OS mio 4k plus"

MTD_BOOTFS = "mmcblk1p1"
MTD_BLACK  = "mmcblk1"

MTD_KERNEL = "mmcblk1p2"
MTD_ROOTFS = "mmcblk1p3"
KERNEL_FILE = "kernel.bin"
ROOTFS_FILE = "rootfs.tar.bz2"

MACHINE_FEATURES += " videoenhancement skins1080 bwlcd128 blindscan-dvbs dvb-c blindscan-dvbc mountboot HDMI eglfs-brcmstb v4l2m2m edision-cortexa15"
OPENPLI_FEATURES += " kodi openhbbtvbrowser"

require conf/machine/include/meta-edision.inc
require conf/machine/include/edision-arm64-common.inc
require conf/machine/include/edision-rootfs-emmc.inc

MACHINE_ESSENTIAL_EXTRA_RDEPENDS:append = " edision-dvb-modules-${MACHINE}"
MACHINE_ESSENTIAL_EXTRA_RRECOMMENDS:append = " kernel-module-qca6174 linux-firmware-qca6174"
MACHINE_ESSENTIAL_EXTRA_RRECOMMENDS:append = " kernel-module-hci-uart kernel-module-btqca"
MACHINE_ESSENTIAL_EXTRA_RRECOMMENDS:append = " wireless-regdb-static"
MACHINE_ESSENTIAL_EXTRA_RRECOMMENDS:append = " resizerootfs"

DVBMEDIASINK_CONFIG = "--with-wma --with-pcm --with-dtsdownmix --with-eac3 --with-h265 --with-vb9"

PREFERRED_PROVIDER_virtual/blindscan-dvbs = "edision-blindscan-utils-${MACHINE}"
PREFERRED_PROVIDER_virtual/blindscan-dvbc = "edision-blindscan-utils-${MACHINE}"
PREFERRED_PROVIDER_virtual/kernel = "linux-edision"
PREFERRED_PROVIDER_virtual/egl = "libv3d-${MACHINE}"
PREFERRED_PROVIDER_virtual/libgles2 = "libv3d-${MACHINE}"

KERNEL_CONSOLE = "ttyS0,115200n8"

SET_QT_QPA_DEFAULT_PLATFORM = "eglfs"
SET_QT_QPA_EGLFS_INTEGRATION = "eglfs_brcmstb"
```

## meta-edision/conf/machine/osnino.conf
```bitbake
#@TYPE: Machine
#@NAME: Edision OS nino
#@DESCRIPTION: Machine configuration for the Edision OS nino

SOC_FAMILY = "bcm7362"
CHIPSET = "bcm7362"

BRAND_OEM = "edision"
MACHINE_BRAND = "Edision"
MACHINE_NAME = "OS nino"

KERNEL_FILE = "kernel.bin"
ROOTFS_FILE = "rootfs.bin"
MTD_KERNEL = "mtd2"
MTD_ROOTFS = "mtd0"

MACHINE_FEATURES += " HDMI dvb-c skins1080 textlcd 7segment"

require conf/machine/include/meta-edision.inc
require conf/machine/include/edision-mips-common.inc
require conf/machine/include/edision-rootfs-ubi.inc

MACHINE_ESSENTIAL_EXTRA_RDEPENDS:append = " edision-dvb-modules-${MACHINE}"
MACHINE_ESSENTIAL_EXTRA_RRECOMMENDS:append = " kernel-module-8723bs linux-firmware-8723bs"
MACHINE_ESSENTIAL_EXTRA_RRECOMMENDS:append = " kernel-module-8723ds linux-firmware-8723ds"
MACHINE_ESSENTIAL_EXTRA_RRECOMMENDS:append = " kernel-module-hci-uart"
MACHINE_EXTRA_RRECOMMENDS:append = " rtk-hciattach"

DVBMEDIASINK_CONFIG = "--with-wma --with-wmv --with-pcm --with-dts --with-eac3"

PREFERRED_PROVIDER_virtual/kernel = "linux-os"
PREFERRED_VERSION_linux-os = "4.8.17"

KERNEL_IMAGETYPE = "vmlinux.gz"
KERNEL_CONSOLE = "ttyS0,115200n8"
```

## meta-gi/conf/machine/et1x000.conf
```bitbake
#@TYPE: Machine
#@NAME: Galaxy Innovations ET11000
#@DESCRIPTION: Machine configuration for the Galaxy Innovations ET11000

SOC_FAMILY = "bcm7251s"
CHIPSET = "bcm7251s"

BRAND_OEM = "xtrend"
MACHINE_BRAND = "Galaxy Innovations"
MACHINE_NAME = "ultramini"

KERNEL_FILE = "kernel.bin"
ROOTFS_FILE = "rootfs.tar.bz2"
MTD_BLACK = "mmcblk0"
MTD_ROOTFS = "mmcblk0p4"
MTD_KERNEL = "mmcblk0p3"

MACHINE_FEATURES += " HDMI nextv-blindscan-dvbc textlcd 7segment dvb-c skins1080 ci mmc nextv-cortexa15"
OPENPLI_FEATURES += " kodi"
DISTRO_FEATURES:remove = "x11 wayland directfb"

PREFERRED_VERSION_linux-nextv = "4.1.37"

require conf/machine/include/nextv-arm.inc
```

## meta-gi/conf/machine/et7000mini.conf
```bitbake
#@TYPE: Machine
#@NAME: Galaxy Innovations ET-7000 Mini
#@DESCRIPTION: Machine configuration for the Galaxy Innovations ET-7000 Mini

SOC_FAMILY = "bcm73625"
CHIPSET = "bcm73625"

BRAND_OEM = "ultramini"
MACHINE_BRAND = "Galaxy Innovations"
MACHINE_NAME = "ET7X00"

MTD_KERNEL = "mtd1"
MTD_ROOTFS = "mtd2"
KERNEL_FILE = "kernel.bin"
ROOTFS_FILE = "rootfs.bin"

MACHINE_FEATURES += " HDMI RCA smallflash blindscan-dvbc blindscan-dvbs videoenhancement dvb-c skins1080 h265"
DISTRO_FEATURES:remove = "x11 wayland directfb"

MKUBIFS_ARGS = "-m 2048 -e 126976 -c 8192"
UBINIZE_ARGS = "-m 2048 -p 128KiB"

PREFERRED_VERSION_linux-nextv = "4.1.21"

require conf/machine/include/nextv-mipsel.inc
```
